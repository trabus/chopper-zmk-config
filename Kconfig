## boards/shields/chopper_unibody/Kconfig.defconfig
```kconfig
if SHIELD_CHOPPER_UNIBODY

config ZMK_KEYBOARD_NAME
    default "Chopper Unibody"

config ZMK_DISPLAY
    bool
    default y

config EC11
    bool
    default y

config CONFIG_ZMK_STUDIO_LOCKING
    bool
    default n
    
endif
```

## config/chopper_unibody/Kconfig.shield
```kconfig
config SHIELD_CHOPPER_UNIBODY
    def_bool $(shields_list_contains,chopper_unibody)
```
